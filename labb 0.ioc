# file: labb 0.ioc
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Mcu.Family=STM32WB
RCC.VCOOutputFreq_Value=32000000
Mcu.Name=STM32WB55RGVx
RCC.APB3Freq_Value=16000000
Mcu.Package=VFQFPN68
ProjectManager.StackSize=0x400
ProjectManager.HeapSize=0x200
ProjectManager.TargetToolchain=STM32CubeIDE
RCC.HSI_VALUE=16000000
NVIC.PriorityGroup=NVIC_PRIORITYGROUP_4
RCC.LSE_VALUE=32768
RCC.HSI48_VALUE=48000000
RCC.HSE_VALUE=8000000
board=custom

// file: Core/Src/main.c
/* USER CODE BEGIN Header */
/**
 ******************************************************************************
 * @file           : main.c
 * @brief          : Main program body
 ******************************************************************************
 * @attention
 *
 * <h2><center>&copy; Copyright (c) 2021 STMicroelectronics.
 * All rights reserved.</center></h2>
 *
 * This software component is licensed by ST under BSD 3-Clause license,
 * the "License"; You may not use this file except in compliance with the
 * License. You may obtain a copy of the License at:
 *                        opensource.org/licenses/BSD-3-Clause
 *
 ******************************************************************************
 */
/* USER CODE END Header */
#include "main.h"

void SystemClock_Config(void);

int main(void)
{
	/* USER CODE BEGIN 1 */

	/* Enable GPIOB */
	SET_BIT(RCC->AHB2ENR, RCC_AHB2ENR_GPIOBEN);
	/* Configure LED (PB.5) as push-pull output, No pull-up, pull-down */

	CLEAR_BIT(GPIOB->MODER, GPIO_MODER_MODE5);
	SET_BIT(GPIOB->MODER, GPIO_MODER_MODE5_0);
	CLEAR_BIT(GPIOB->OTYPER, GPIO_OTYPER_OT5);
	CLEAR_BIT(GPIOB->OSPEEDR, GPIO_OSPEEDR_OSPEED5);
	SET_BIT(GPIOB->OSPEEDR, GPIO_OSPEEDR_OSPEED5_0);
	CLEAR_BIT(GPIOB->PUPDR, GPIO_PUPDR_PUPD5);

	/* Enable GPIOC */

	SET_BIT(RCC->AHB2ENR, RCC_AHB2ENR_GPIOCEN);
	CLEAR_BIT(GPIOC->MODER, GPIO_MODER_MODE4);
	CLEAR_BIT(GPIOC->OSPEEDR, GPIO_OSPEEDR_OSPEED4);
	SET_BIT(GPIOC->OSPEEDR, GPIO_OSPEEDR_OSPEED4_0);
	CLEAR_BIT(GPIOC->PUPDR, GPIO_PUPDR_PUPD4);
	SET_BIT(GPIOC->PUPDR, GPIO_PUPDR_PUPD4_0);
	/* Infinite loop */

	while(1) {
		if   (!READ_BIT(GPIOC->IDR  , GPIO_IDR_ID4)) {
			GPIOB->ODR   ^= GPIO_ODR_OD5;
		}
		else
			CLEAR_BIT(GPIOB->ODR , GPIO_ODR_OD5);
		for(int i = 0; i < 100000; i++)__NOP();
	}

	/* USER CODE END 1 */

	/* MCU Configuration--------------------------------------------------------*/

	/* Reset of all peripherals, Initializes the Flash interface and the Systick. */
	HAL_Init();

	/* Configure the system clock */
	SystemClock_Config();

	/* Initialize all configured peripherals */

	/* Infinite loop */
	while (1)
	{

	}
}

void SystemClock_Config(void)
{
	RCC_OscInitTypeDef RCC_OscInitStruct = {0};
	RCC_ClkInitTypeDef RCC_ClkInitStruct = {0};
	RCC_PeriphCLKInitTypeDef PeriphClkInitStruct = {0};

	/** Configure the main internal regulator output voltage
	 */
	__HAL_PWR_VOLTAGESCALING_CONFIG(PWR_REGULATOR_VOLTAGE_SCALE1);
	/** Initializes the RCC Oscillators according to the specified parameters
	 * in the RCC_OscInitTypeDef structure.
	 */
	RCC_OscInitStruct.OscillatorType = RCC_OSCILLATORTYPE_HSI|RCC_OSCILLATORTYPE_MSI;
	RCC_OscInitStruct.HSIState = RCC_HSI_ON;
	RCC_OscInitStruct.MSIState = RCC_MSI_ON;
	RCC_OscInitStruct.HSICalibrationValue = RCC_HSICALIBRATION_DEFAULT;
	RCC_OscInitStruct.MSICalibrationValue = RCC_MSICALIBRATION_DEFAULT;
	RCC_OscInitStruct.MSIClockRange = RCC_MSIRANGE_6;
	RCC_OscInitStruct.PLL.PLLState = RCC_PLL_NONE;
	if (HAL_RCC_OscConfig(&RCC_OscInitStruct) != HAL_OK)
	{
		Error_Handler();
	}
	/** Configure the SYSCLKSource, HCLK, PCLK1 and PCLK2 clocks dividers
	 */
	RCC_ClkInitStruct.ClockType = RCC_CLOCKTYPE_HCLK4|RCC_CLOCKTYPE_HCLK2
			|RCC_CLOCKTYPE_HCLK|RCC_CLOCKTYPE_SYSCLK
			|RCC_CLOCKTYPE_PCLK1|RCC_CLOCKTYPE_PCLK2;
	RCC_ClkInitStruct.SYSCLKSource = RCC_SYSCLKSOURCE_MSI;
	RCC_ClkInitStruct.AHBCLKDivider = RCC_SYSCLK_DIV1;
	RCC_ClkInitStruct.APB1CLKDivider = RCC_HCLK_DIV1;
	RCC_ClkInitStruct.APB2CLKDivider = RCC_HCLK_DIV1;
	RCC_ClkInitStruct.AHBCLK2Divider = RCC_SYSCLK_DIV1;
	RCC_ClkInitStruct.AHBCLK4Divider = RCC_SYSCLK_DIV1;

	if (HAL_RCC_ClockConfig(&RCC_ClkInitStruct, FLASH_LATENCY_0) != HAL_OK)
	{
		Error_Handler();
	}
	/** Initializes the peripherals clocks
	 */
	PeriphClkInitStruct.PeriphClockSelection = RCC_PERIPHCLK_SMPS;
	PeriphClkInitStruct.SmpsClockSelection = RCC_SMPSCLKSOURCE_HSI;
	PeriphClkInitStruct.SmpsDivSelection = RCC_SMPSCLKDIV_RANGE1;
	if (HAL_RCCEx_PeriphCLKConfig(&PeriphClkInitStruct) != HAL_OK)
	{
		Error_Handler();
	}
}

void Error_Handler(void)
{
	__disable_irq();
	while (1)
	{
	}
}

/************************ (C) COPYRIGHT STMicroelectronics *****END OF FILE****/
